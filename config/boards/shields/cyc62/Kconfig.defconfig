## config/boards/shields/cyc62/Kconfig.defconfig
```kconfig
if SHIELD_CYC62_LEFT

config ZMK_KEYBOARD_NAME
    default "cyc62"

config ZMK_SPLIT_ROLE_CENTRAL
    default y

endif

if SHIELD_CYC62_LEFT || SHIELD_CYC62_RIGHT

config ZMK_SPLIT
    default y

endif
```

## config/boards/shields/cyc62/Kconfig.shield
```kconfig
config SHIELD_CYC62_LEFT
    def_bool $(shields_list_contains,cyc62_left)

config SHIELD_CYC62_RIGHT
    def_bool $(shields_list_contains,cyc62_right)
```
